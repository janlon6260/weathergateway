## firmware/sdkconfig.defaults
```kconfig
CONFIG_IDF_TARGET="esp32"
CONFIG_ESPTOOLPY_FLASHSIZE_4MB=y
CONFIG_PARTITION_TABLE_CUSTOM=y
CONFIG_PARTITION_TABLE_CUSTOM_FILENAME="partitions.csv"
CONFIG_BOOTLOADER_APP_ROLLBACK_ENABLE=y
CONFIG_ESP_MAIN_TASK_STACK_SIZE=12288
CONFIG_MBEDTLS_DYNAMIC_BUFFER=y
CONFIG_MBEDTLS_CERTIFICATE_BUNDLE=y
CONFIG_FREERTOS_HZ=1000
CONFIG_COMPILER_STACK_CHECK_MODE_STRONG=y
CONFIG_LOG_DEFAULT_LEVEL_INFO=y
CONFIG_MQTT_PROTOCOL_5=y
CONFIG_WL_SECTOR_SIZE_4096=y
```
